## boards/shields/wtb56/Kconfig.defconfig
```kconfig
if SHIELD_WTB56_RIGHT

config ZMK_KEYBOARD_NAME
    default "wtb56"

endif

if SHIELD_WTB56_LEFT || SHIELD_WTB56_RIGHT

config ZMK_SPLIT
    default y

endif
```

## boards/shields/wtb56/Kconfig.shield
```kconfig
config SHIELD_WTB56_LEFT
    def_bool $(shields_list_contains,wtb56_left)
config SHIELD_WTB56_RIGHT
    def_bool $(shields_list_contains,wtb56_right)
```

## config/west.yml
```yaml
manifest:
  remotes:
    - name: zmkfirmware
      url-base: https://github.com/zmkfirmware
    - name: sekigon-gonnoc
      url-base: https://github.com/sekigon-gonnoc
    - name: joelspadin
      url-base: https://github.com/joelspadin
  projects:
    - name: zmk
      remote: zmkfirmware
      revision: v0.2
      import: app/west.yml
    - name: zmk-driver-paw3222
      remote: sekigon-gonnoc
      revision: main
    - name: zmk-locales
      remote: joelspadin
      revision: main
  self:
    path: config
```
